// SPDX-License-Identifier: GPL-2.0-only
// SPDX-FileCopyrightText: Copyright (c) 2023, NVIDIA CORPORATION & AFFILIATES.  All rights reserved.
/*
 * Device-tree overlay for Wolfram WM8904
 * tegra234-p3767-0000 based platforms.
 */

/dts-v1/;
/plugin/;

#include <dt-bindings/tegra234-p3767-0000-common.h>
#include <overlay/jetson-audio-wm8904.dtsi>
#include <overlay/jetson-display-1440x1600.dtsi>
